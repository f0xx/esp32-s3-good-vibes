## CMakeLists.txt
```
cmake_minimum_required(VERSION 3.20.0)
find_package(Zephyr REQUIRED HINTS $ENV{ZEPHYR_BASE})
project(waveshare_handshake)

target_include_directories(app PRIVATE
  ${CMAKE_CURRENT_SOURCE_DIR}/src
)

# Prefer space-free west links. CMake REALPATHs the handshake symlink, so a
# relative ../waveshare-common misses. Spaces in the repo path break the
# Xtensa assembler .file directive.
set(_link_common "")
if(DEFINED ENV{ZEPHYR_PROJECT} AND EXISTS "$ENV{ZEPHYR_PROJECT}/waveshare-common/fw_version.h")
  set(_link_common "$ENV{ZEPHYR_PROJECT}/waveshare-common")
elseif(DEFINED ENV{HOME} AND EXISTS "$ENV{HOME}/zephyrproject/waveshare-common/fw_version.h")
  set(_link_common "$ENV{HOME}/zephyrproject/waveshare-common")
endif()
if(_link_common)
  set(COMMON_DIR "${_link_common}")
else()
  get_filename_component(APP_ROOT ${CMAKE_CURRENT_SOURCE_DIR} REALPATH)
  set(COMMON_DIR ${APP_ROOT}/../common)
endif()

target_include_directories(app PRIVATE ${COMMON_DIR})

message(STATUS "handshake COMMON_DIR=${COMMON_DIR}")

target_sources(app PRIVATE
  src/main.c
  src/ble_looper.c
  src/ble_imu_gatt.c
  src/ble_net_gatt.c
  src/ble_config_gatt.c
  src/ble_crash_gatt.c
  src/ble_ota_gatt.c
  src/boot_button.c
  src/display_panel.c
  src/imu_pipeline.c
  src/panel_draw.c
  src/panel_font_glcd.c
  ${COMMON_DIR}/renderer.c
  src/mt200_bridge.c
  src/mt200_sample_queue.c
  src/qmi8658.c
  src/scene_live.c
  src/ws2812_gpio38.c
  src/vibro_led.c
  ${COMMON_DIR}/battery_bench.c
  ${COMMON_DIR}/battery_adc_esp32.c
  ${COMMON_DIR}/attitude.c
  ${COMMON_DIR}/battery_monitor.c
  ${COMMON_DIR}/chip_temp.c
  ${COMMON_DIR}/clock_sync.c
  ${COMMON_DIR}/clock_sync_ntp.c
  ${COMMON_DIR}/bist.c
  ${COMMON_DIR}/crash_debug.c
  ${COMMON_DIR}/crash_report.c
  ${COMMON_DIR}/crash_alive.c
  ${COMMON_DIR}/crash_ring_store.c
  ${COMMON_DIR}/crash_rtc_capture.c
  ${COMMON_DIR}/device_config.c
  ${COMMON_DIR}/ota_ab.c
  ${COMMON_DIR}/ota_channel.c
  ${COMMON_DIR}/ota_wifi.c
  ${COMMON_DIR}/soft_reboot.c
  ${COMMON_DIR}/device_profile.c
  ${COMMON_DIR}/flash_safety.c
  ${COMMON_DIR}/floor_calib.c
  ${COMMON_DIR}/imu_cal.c
  ${COMMON_DIR}/net_profile_store.c
  ${COMMON_DIR}/network_manager.c
  ${COMMON_DIR}/panel_backlight.c
  ${COMMON_DIR}/power_manager.c
  ${COMMON_DIR}/radio_scheduler.c
  ${COMMON_DIR}/projection.c
  ${COMMON_DIR}/scene_snapshot.c
  ${COMMON_DIR}/scene_zoom.c
  ${COMMON_DIR}/stall_watchdog.c
  ${COMMON_DIR}/vibro_capture.c
  ${COMMON_DIR}/vibro_band_rms.c
  ${COMMON_DIR}/vibro_fft.c
  ${COMMON_DIR}/metrics_compact.c
  ${COMMON_DIR}/vibro_features.c
  ${COMMON_DIR}/vibro_verdict_store.c
  ${COMMON_DIR}/vibro_ref_store.c
  ${COMMON_DIR}/vibro_schedule.c
  ${COMMON_DIR}/walk_distance.c
)

target_link_libraries(app PRIVATE m)

# Espressif heap Kconfig → compile defs (heap_caps_zephyr still uses k_malloc;
# SYS_HEAP_HARDENING_* does the real canary work. These defs keep IDF headers
# and any multi_heap paths consistent when present).
if(CONFIG_HEAP_POISONING_LIGHT OR CONFIG_HEAP_POISONING_COMPREHENSIVE)
  zephyr_compile_definitions(MULTI_HEAP_POISONING=1)
endif()
if(CONFIG_HEAP_POISONING_COMPREHENSIVE)
  zephyr_compile_definitions(MULTI_HEAP_POISONING_SLOW=1)
endif()
```

## Kconfig
```
mainmenu "Handshake application"

source "Kconfig.zephyr"

config APP_CRASH_DEBUG
	bool "Field debug extras (MT200, crash inject, BIST)"
	default n
	help
	  Enables MT200 watch bridge, BLE crash inject, and BIST. Desk/debug
	  builds merge prj_crash.conf; stable OTA merges prj_release.conf which
	  also sets this so the watch path stays available without inject-heavy
	  assert/sentinel options.

config APP_STALL_WATCHDOG
	bool "Soft main/render stall task watchdog"
	depends on TASK_WDT
	default y
	help
	  Arm Zephyr task_wdt channels for main + render. Desk hang-hunts often
	  prefer this off (OpenOCD/GDB) — set n in prj_crash.conf. Stable OTA
	  keeps it on via prj_release.conf.

config APP_STACK_RA_CHECK
	bool "Manual return-address canaries (STACK_RA_CHECK)"
	default n
	help
	  Cheap smash detection: save __builtin_return_address(0) at entry and
	  re-check mid-function (rkd.me.uk stack-corruption post). Desk only.

config APP_FUNC_TRACE
	bool "ERR-level enter/leave breadcrumbs (stall hunt)"
	default n
	help
	  Emit LOG_ERR ">> func" / "<< func" at APP_ENTER/APP_LEAVE sites.
	  Intended for desk crash-debug images — serial storm until a stall.

config APP_PANEL_SPI_MHZ
	int "Panel SPI clock reported in STATUS (MHz)"
	default 20
	help
	  Must match the st7789v mipi-max-frequency actually built. Desk stays
	  20 (GPIO-matrix spec). Release overlay raises the panel to 40 and
	  sets this to 40 so Insights does not lie.

config APP_WIFI_OTA
	bool "WiFi CDN self-OTA (HTTPS)"
	default n
	depends on NET_TCP && DNS_RESOLVER && NET_SOCKETS_SOCKOPT_TLS
	help
	  When onboard WiFi is configured and linked, periodically pull the
	  preferred CDN channel (stable/staging/dev) and stage firmware via
	  flash_img + MCUboot A/B like BLE OTA. Off by default: enabling TLS
	  blew past safe DRAM on ESP32-S3 (hangs). Channel sync still works.

# --- Espressif heap / HAL debug (mirrors IDF components/heap + components/hal) ---
# Zephyr's ESP port routes heap_caps → k_malloc (sys_heap), so IDF multi_heap
# poisoning is not linked; these symbols still drive compile defs + doc, and we
# pair them with CONFIG_SYS_HEAP_HARDENING_* which is what actually canaries
# the allocator used by BT/WiFi/app.

choice HEAP_CORRUPTION_DETECTION
	prompt "Heap corruption detection (ESP-IDF style)"
	default HEAP_POISONING_DISABLED
	help
	  Desk soak: prefer COMPREHENSIVE with SYS_HEAP_HARDENING_FULL.

config HEAP_POISONING_DISABLED
	bool "Basic (no poisoning)"
config HEAP_POISONING_LIGHT
	bool "Light impact"
config HEAP_POISONING_COMPREHENSIVE
	bool "Comprehensive"
endchoice

choice HEAP_TRACING_DEST
	bool "Heap tracing (ESP-IDF style)"
	default HEAP_TRACING_OFF

config HEAP_TRACING_OFF
	bool "Disabled"
config HEAP_TRACING_STANDALONE
	bool "Standalone"
config HEAP_TRACING_TOHOST
	bool "Host-based"
endchoice

config HEAP_TRACING
	bool
	default n if HEAP_TRACING_OFF
	default y if !HEAP_TRACING_OFF

config HEAP_TRACING_STACK_DEPTH
	int "Heap tracing stack depth"
	depends on HEAP_TRACING
	range 0 32
	default 8

config HEAP_ABORT_WHEN_ALLOCATION_FAILS
	bool "Abort if memory allocation fails"
	default n

choice HAL_DEFAULT_ASSERTION_LEVEL
	bool "Default HAL assertion level"
	default HAL_ASSERTION_EQUALS_SYSTEM
	help
	  From espressif components/hal/Kconfig.

config HAL_ASSERTION_EQUALS_SYSTEM
	bool "Same as system assertion level"
config HAL_ASSERTION_DISABLE
	bool "Disabled"
config HAL_ASSERTION_SILENT
	bool "Silent"
config HAL_ASSERTION_ENABLE
	bool "Enabled"
endchoice
```

## sysbuild.conf
```
# Factory + OTA A/B: MCUboot at 0x0, signed handshake in slot0/slot1.
SB_CONFIG_BOOTLOADER_MCUBOOT=y
```

## prj.conf
```kconfig
# v313: Invalid SP smash during imu_poll — give main more room under BLE+I2C.
CONFIG_MAIN_STACK_SIZE=24576
# 4.x ESP WiFi/BT ADD_SIZE_* sum (~76 KiB) + board would exceed DRAM; keep the
# proven 64 KiB system heap (DMA/INTERNAL still forced to DRAM by the wifi
# dma-dram patch; net pkts can use SPIRAM via ESP32_WIFI_NET_ALLOC_SPIRAM).
# (IDF "prod" tip uses 48 KiB — we stay higher for dual stacks + display.)
CONFIG_HEAP_MEM_POOL_SIZE=65536
CONFIG_HEAP_MEM_POOL_IGNORE_MIN=y
CONFIG_SYSTEM_WORKQUEUE_STACK_SIZE=8192
# Prefer UI/sensor work over background net/BT completions (Zephyr default).
CONFIG_SYSTEM_WORKQUEUE_PRIORITY=-1
# ESP32 WiFi driver depends on !SMP (drivers/wifi/esp32/Kconfig.esp32). Do not
# enable CONFIG_SMP — it silently disables CONFIG_WIFI_ESP32.
# CONFIG_SMP is not set
CONFIG_MULTITHREADING=y
# Diagnostic: a stack overflow on Xtensa/ESP32 tends to manifest as a raw
# double-exception -> hardware TG0WDT_SYS_RST (no Zephyr fatal report, nothing
# in crash_ring — see vibro_capture.c/vibro_band_rms.c static-buffer fix for
# the specific bug this caught). Sentinel check adds a canary word so future
# overflows have a better chance of surfacing as a clean k_sys_fatal_error
# (captured by crash_report) instead of a silent hard reset.
# L1 interrupts were re-entering _handle_excint during the window spill
# and livelocking (frozen uptime, PC in xtensa_save_high_regs, garbage A0).
# Handlers must not preempt each other. 2 KiB ISR stack is too small for
# one ESP32 BT frame plus the spill.
CONFIG_XTENSA_INTERRUPT_NONPREEMPTABLE=y
CONFIG_ISR_STACK_SIZE=4096
CONFIG_STACK_SENTINEL=y
CONFIG_LOG=y
CONFIG_LOG_MODE_IMMEDIATE=y
CONFIG_CONSOLE=y
CONFIG_SERIAL=y
CONFIG_UART_CONSOLE=y
CONFIG_DISPLAY=y
CONFIG_GPIO=y
CONFIG_INPUT=y
CONFIG_I2C=y
CONFIG_PWM=y
# Zephyr ADC driver provides adc_lock/arbiter symbols for battery_adc_esp32.c HAL path.
# Keep &adc1 disabled in DTS — enabling it corrupts curve-fit reads (~9.2V bug).
CONFIG_ADC=y
CONFIG_SENSOR=y
CONFIG_ESP32_TEMP=y

# WiFi STA is compiled in but stays down until BLE net scan/connect
# (network_manager ensure_wifi_up). radio_scheduler pauses IMU NOTIFY and
# stretches the phone BLE interval while scan/connect is in progress.
#
# --- ESP32-S3 WiFi + BLE coexistence (Zephyr 4.4 / HAL names) ---
# IDF "prod" snippets use CONFIG_BT_CTRL_PINNED_TO_CORE_* and
# CONFIG_ESP_WIFI_TASK_CORE_ID; under Zephyr those map to:
#   CONFIG_ESP32_BT_CTLR_PINNED_TO_CORE=<0|1>
#   CONFIG_ESP_WIFI_TASK_PINNED_TO_CORE_{0,1}
# CONFIG_ESP32_SW_COEXIST_ENABLE defaults y when BT_ESP32 && WIFI_ESP32
# (soc/espressif/common/Kconfig) — do not set the IDF-only
# CONFIG_ESP_COEX_SW_COEXIST_ENABLE name.
CONFIG_WIFI=y
CONFIG_WIFI_ESP32=y
CONFIG_NETWORKING=y
CONFIG_NET_L2_ETHERNET=y
CONFIG_NET_IPV4=y
CONFIG_NET_IPV6=n
CONFIG_NET_DHCPV4=y
CONFIG_ESP32_WIFI_STA_AUTO_DHCPV4=y
CONFIG_NET_MGMT=y
CONFIG_NET_MGMT_EVENT=y
CONFIG_NET_UDP=y
# App traffic is UDP (NTP) + DHCP. TCP/TLS/mbedtls for WiFi CDN self-OTA pushed
# dram0 to ~96% and hung field boards — keep off until SPIRAM-backed TLS lands.
CONFIG_NET_TCP=n
CONFIG_NET_SOCKETS=y
CONFIG_NET_CONTEXT_NET_PKT_POOL=y
CONFIG_BT_L2CAP_DYNAMIC_CHANNEL=y
CONFIG_BT_USER_DATA_LEN_UPDATE=y
CONFIG_BT_SMP=y

# Net pkt/buf pools live in SPIRAM when ESP32_WIFI_NET_ALLOC_SPIRAM=y.
# Midway between old 6/12 (buffer starve) and IDF tip 16/32 (heavy).
CONFIG_NET_PKT_RX_COUNT=12
CONFIG_NET_PKT_TX_COUNT=12
CONFIG_NET_BUF_RX_COUNT=24
CONFIG_NET_BUF_TX_COUNT=24
CONFIG_NET_MAX_CONN=4
CONFIG_NET_MAX_CONTEXTS=6
# WiFi DMA buffers must stay in DRAM (see apply-esp32-wifi-dma-dram.sh).
CONFIG_ESP32_WIFI_STATIC_RX_BUFFER_NUM=4
CONFIG_ESP32_WIFI_DYNAMIC_RX_BUFFER_NUM=8
CONFIG_ESP32_WIFI_STATIC_TX_BUFFER=y
CONFIG_ESP32_WIFI_STATIC_TX_BUFFER_NUM=4
CONFIG_NET_MGMT_EVENT_QUEUE_SIZE=24
CONFIG_ESP32_WIFI_AMPDU_TX_ENABLED=n
CONFIG_ESP32_WIFI_AMPDU_RX_ENABLED=n
CONFIG_ESP32_WIFI_ENABLE_WPA3_SAE=n
CONFIG_ESP32_WIFI_ENABLE_WPA3_OWE_STA=n
# IDF tip enables IRAM_OPT for WiFi preference; on this board IRAM fights the
# BT controller (v102 coex hunt). Prefer DRAM/Flash for WiFi lib code.
CONFIG_ESP32_WIFI_IRAM_OPT=n
CONFIG_ESP32_WIFI_RX_IRAM_OPT=n
# ESP_HEAP_MIN_EXTRAM_THRESHOLD removed in Zephyr 4.x. Keep WiFi OSI allocs on
# the system (DRAM) heap; MAC _malloc_internal is forced to DRAM by
# apply-esp32-wifi-dma-dram.sh (__real_k_malloc).
# CONFIG_ESP32_WIFI_CACHE_TX_BUFFER_NUM only applies with ESP_WIFI_HEAP_SPIRAM.
CONFIG_ESP_WIFI_HEAP_SYSTEM=y
# Separate radio tasks across the two S3 CPUs (Zephyr itself stays UP-only).
# IDF snippets often pin *both* to core 0; we actually split them.
CONFIG_ESP_WIFI_TASK_PINNED_TO_CORE_0=y
CONFIG_ESP32_BT_CTLR_PINNED_TO_CORE=1

CONFIG_BT=y
CONFIG_BT_PERIPHERAL=y
CONFIG_BT_DEVICE_NAME="ESP32S3 IMU sim"
CONFIG_BT_DEVICE_NAME_DYNAMIC=n
# BT_MAX_CONN=3: peripheral link to phone + experimental central link to the
# MT200 bridge (mt200_bridge.c, CONFIG_APP_CRASH_DEBUG only) + headroom for a
# debug-tool peripheral link (e.g. laptop triggering the mt200_scan op over
# ble_crash_gatt) while still advertising (advertising itself reserves a
# connection object). BT_CENTRAL/BT_GATT_CLIENT/BT_OBSERVER are needed for
# that scan->connect->discover flow.
CONFIG_BT_MAX_CONN=3
CONFIG_BT_CENTRAL=y
CONFIG_BT_GATT_CLIENT=y
CONFIG_BT_MAX_PAIRED=0
CONFIG_BT_RX_STACK_SIZE=8192
CONFIG_BT_RECV_WORKQ_BT=y
# bt_tx_processor workqueue thread (NOT BT_HCI_TX_STACK): desk soak showed
# unused=8/1024 (99%) for hours before a silent USB/board freeze — same smash
# class as the old BT LW WQ@1400. This symbol has a Kconfig prompt.
CONFIG_BT_TX_PROCESSOR_STACK_SIZE=2048
# BT_LONG_WQ_STACK_SIZE is hidden (no prompt) — forced to 3072 via
# platform/apply-bt-long-wq-stack.sh (Kconfig default patch), not here.
# Upstream Zephyr issue #92224 + desk: with BT_ECC=y the stock default is
# 1400 and thread_analyzer shows unused=28/1408 (98%) overnight — overflow
# there corrupts adjacent stacks (render Invalid SP / LoadProhibited@0).
# Forced to 3072 (4096 + desk -Og overflowed dram0 by ~856B).
# NOTE: tried disabling BT_AUTO_PHY_UPDATE/BT_AUTO_DATA_LEN_UPDATE/
# BT_GAP_AUTO_UPDATE_CONN_PARAMS/BT_GATT_CACHING (v100) — made things WORSE
# (new idle crashes on "wifi" thread with no connection at all). Reverted.

CONFIG_BT_L2CAP_TX_MTU=517
CONFIG_BT_BUF_ACL_RX_SIZE=517
CONFIG_BT_BUF_ACL_TX_SIZE=517
# Smaller host ACL pools — large RX/TX counts correlated with dual-role MSPI
# smash under desk GDB soak. Keep 517B MTU/DLE; cut buffer *count*.
# total ACL RX ≈ BT_MAX_CONN + 1 + EXTRA → aim ~6–7.
CONFIG_BT_BUF_ACL_RX_COUNT_EXTRA=2
CONFIG_BT_BUF_ACL_TX_COUNT=6
CONFIG_BT_BUF_CMD_TX_COUNT=4
CONFIG_BT_BUF_EVT_DISCARDABLE_COUNT=8

CONFIG_CBPRINTF_FP_SUPPORT=y

# PSRAM (8 MB octal): framebuffer in .ext_ram.bss frees internal DRAM for WiFi+BT.
CONFIG_ESP_SPIRAM=y
CONFIG_SPIRAM_MODE_OCT=y
CONFIG_ESP_SPIRAM_SIZE=8388608
CONFIG_ESP_SPIRAM_HEAP_SIZE=524288
CONFIG_ESP32_WIFI_NET_ALLOC_SPIRAM=y

CONFIG_SETTINGS=y
CONFIG_SETTINGS_RUNTIME=y
CONFIG_SETTINGS_NVS=y
CONFIG_NVS=y
CONFIG_FLASH=y
CONFIG_FLASH_MAP=y
CONFIG_STREAM_FLASH=y
CONFIG_IMG_MANAGER=y
CONFIG_MCUBOOT_IMG_MANAGER=y
CONFIG_BOOTLOADER_MCUBOOT=y
CONFIG_MCUBOOT_GENERATE_CONFIRMED_IMAGE=y
# bootutil logs "Image index / Swap type" at INF on every mcuboot_swap_type()
# (STATUS JSON used to call that each poll). Cache + this keeps serial usable.
CONFIG_MCUBOOT_UTIL_LOG_LEVEL_WRN=y
# Keep in sync with zephyr/app/common/fw_version.h (flash/ci also pass -D from that header).
CONFIG_MCUBOOT_IMGTOOL_SIGN_VERSION="0.0.247"
# Progressive erase during BLE DATA writes resets this board (flash_area_erase
# with a live LE link → TG0WDT). Pre-erase slot1 while disconnected instead
# (ble_ota_gatt.c); stream_flash then only programs already-blank pages.
CONFIG_IMG_ERASE_PROGRESSIVELY=n
CONFIG_REBOOT=y
```

## prj_crash.conf
```kconfig
# Crash diagnostics — merged by flash-zephyr.sh when CRASH_DEBUG=1.
# Canonical settings: docs/crash-reporting-roadmap.md
#
# IMPORTANT: do NOT use CONFIG_DEBUG_COREDUMP_BACKEND_FLASH_PARTITION here
# (flash write from the fatal path double-faults on ESP32-S3).
#
# Logging-backend coredump (#CD on USB) is useful for desk gdb but poisons RTC
# capture PC (records coredump_* instead of the fault) and can wedge on Invalid SP.
# Field/desk crash path: RTC breadcrumb + crash ring only — use esp_coredump.sh only
# when temporarily flipping these on for a known-good SP fault.
# CONFIG_DEBUG_COREDUMP is not set
# CONFIG_DEBUG_COREDUMP_BACKEND_LOGGING is not set

CONFIG_STACK_SENTINEL=y
# Paint stacks 0xaa — thread analyzer high-water + smash forensics.
CONFIG_INIT_STACKS=y
# GCC stack-protector OFF for desk soak. v310–v312 DoubleException showed
# Invalid SP (0xffffff80) + LoadProhibited@0x2c; canary instrumentation on
# every IRAM I2C/SPI frame correlated with smash. Rely on STACK_SENTINEL +
# APP_STACK_RA_CHECK + ext-bus mutex instead.
# CONFIG_STACK_CANARIES is not set
# CONFIG_STACK_CANARIES_STRONG is not set
# CONFIG_STACK_CANARIES_ALL is not set
CONFIG_ENTROPY_GENERATOR=y
CONFIG_ASSERT=y
CONFIG_THREAD_NAME=y
CONFIG_THREAD_MONITOR=y
CONFIG_THREAD_STACK_INFO=y

# Soft task WDT — OFF on desk. False render-hb / feed_render Issues noise while
# OpenOCD hang-hunt is the primary desk tool. Stable OTA keeps TASK_WDT via
# prj_release.conf + CONFIG_APP_STALL_WATCHDOG=y.
# CONFIG_WATCHDOG is not set
# CONFIG_TASK_WDT is not set
# CONFIG_APP_STALL_WATCHDOG is not set

# Cheap RA canaries on hot paths (render flush / IMU tick) — see stack_ra_check.h.
CONFIG_APP_STACK_RA_CHECK=y

# Step 4 — debug-only crash inject + BIST (never enable in production images).
CONFIG_APP_CRASH_DEBUG=y

# Off for the render-fault hunt: IMMEDIATE LOG + >>func flood on BT/IMU paths
# amplified UART stalls that look like render death. Re-enable for bring-up.
# CONFIG_APP_FUNC_TRACE is not set

# Keep LOG_MODE_IMMEDIATE (prj.conf). DEFERRED (v266) soft-rebooted ~370ms into
# boot at power_manager with zero USB FATAL — k_sys_fatal_error_handler reboots
# before the deferred backend can flush. USB wedge: cut spam (gatt→DBG, no AUTO
# analyzer) rather than deferred until log-thread stack is proven.

# Desk: thread analyzer on demand — AUTO every 30s garbled USB under IMMEDIATE.
CONFIG_THREAD_ANALYZER=y
CONFIG_THREAD_ANALYZER_USE_LOG=y
# CONFIG_THREAD_ANALYZER_AUTO is not set
CONFIG_THREAD_ANALYZER_AUTO_STACK_SIZE=2560

# -Os puts locals in registers, so GDB watches show <optimized out>.
# CONFIG_DEBUG selects -Og. Slots are 3 MiB (16 MB flash) so this fits.
# -O0 still does not: it blows even a 3 MiB slot and changes the SPI/BT race.
CONFIG_DEBUG=y
CONFIG_DEBUG_OPTIMIZATIONS=y
CONFIG_FRAME_POINTER=y

# Espressif-style heap corruption / tracing + HAL asserts (see app Kconfig).
# Real allocator protection on Zephyr-ESP is SYS_HEAP_* (heap_caps → k_malloc).
CONFIG_HEAP_POISONING_COMPREHENSIVE=y
CONFIG_HEAP_TRACING_STANDALONE=y
CONFIG_HEAP_TRACING_STACK_DEPTH=8
# HEAP_ABORT_WHEN_ALLOCATION_FAILS needs esp_system_abort (not in Zephyr port).
CONFIG_HAL_ASSERTION_ENABLE=y
CONFIG_SYS_HEAP_HARDENING_FULL=y
CONFIG_ASSERT_ON_ERRORS=y
CONFIG_BT_ASSERT_PANIC=y

# Leave off until we need lock-contention evidence (UART cost + overhead):
#   CONFIG_TRACING=y + mutex tracing APIs / SystemView (see roadmap "Desk SMP").
# CONFIG_SCHED_CPU_MASK is debated for ESP32-S3 dual-core — do not enable here.
```

## prj_release.conf
```kconfig
# Production overlay (merged when CRASH_DEBUG=0). Staging and stable both use this.
# CONFIG_APP_CRASH_DEBUG must stay y — it also gates MT200 and other field paths.
# -O2, no desk -Og. Flashed zephyr.bin has no DWARF either way.
# Panel SPI is 40 MHz via app/handshake/panel_40mhz.overlay (I2C stays 400 kHz).

CONFIG_SPEED_OPTIMIZATIONS=y
CONFIG_APP_CRASH_DEBUG=y
CONFIG_APP_PANEL_SPI_MHZ=40

CONFIG_WATCHDOG=y
CONFIG_TASK_WDT=y
# Do NOT enable HW fallback on ESP32-S3. Zephyr's wdt_esp32 passes window.max
# (ms) straight into wdt_hal_config_stage() which expects MWDT ticks
# (ESP-IDF uses timeout_ms * (1000 / TICKS_PER_US)). The mistimed TG0 MWDT
# was the classic ~13.5s empty-PC task_wdt flood. Soft main/render channels
# still catch stalls while the kernel can run.
CONFIG_TASK_WDT_HW_FALLBACK=n
CONFIG_TASK_WDT_CHANNELS=4
CONFIG_APP_STALL_WATCHDOG=y

CONFIG_THREAD_NAME=y
CONFIG_THREAD_MONITOR=y

# No assert storms in the field (desk uses prj_crash.conf). Keep stack sentinel —
# render InstrFetch@0 after minutes often means a smashed return address.
CONFIG_STACK_SENTINEL=y
CONFIG_ASSERT=n

# No logging/flash coredump — see prj_crash.conf. RTC capture + reboot only.
# CONFIG_DEBUG_COREDUMP is not set
```

## panel_40mhz.overlay
```dts
/* Release-only. Desk DTS stays 20 MHz (GPIO-matrix spec). */
&st7789v {
	mipi-max-frequency = <40000000>;
};
```

## src/main.c
```c
/*
 * Waveshare ESP32-S3-LCD-1.47B — mobile app handshake + live scene (Zephyr parity)
 */

#include <zephyr/bluetooth/bluetooth.h>
#include <zephyr/device.h>
#include <zephyr/devicetree.h>
#include <zephyr/kernel.h>
#include <zephyr/logging/log.h>
#include <zephyr/settings/settings.h>
#include <zephyr/sys/printk.h>
#include <stdint.h>

#include "battery_monitor.h"
#include "app_func_trace.h"
#include "board_config.h"
#include "chip_temp.h"
#include "ble_config_gatt.h"
#include "ble_crash_gatt.h"
#include "ble_looper.h"
#include "device_config.h"
#include "battery_bench.h"
#include "ble_imu_gatt.h"
#include "ble_net_gatt.h"
#include "ble_ota_gatt.h"
#include "boot_button.h"
#include "bist.h"
#include "crash_alive.h"
#include "crash_debug.h"
#include "crash_report.h"
#include "fw_version.h"
#include "display_panel.h"
#include "imu_pipeline.h"
#include "network_manager.h"
#include "ota_ab.h"
#include "ota_channel.h"
#include "ota_wifi.h"
#include "panel_backlight.h"
#include "renderer.h"
#include "power_manager.h"
#include "scene_live.h"
#include "soft_reboot.h"
#include "radio_scheduler.h"
#include "stall_watchdog.h"
#include "clock_sync.h"
#include "vibro_capture.h"
#include "vibro_schedule.h"
#include "ws2812_gpio38.h"
#include "vibro_led.h"
#include "mt200_bridge.h"
#include "mt200_sample_queue.h"
#include "stack_ra_check.h"

LOG_MODULE_REGISTER(handshake, LOG_LEVEL_INF);

static const struct device *const display_dev =
	DEVICE_DT_GET(DT_CHOSEN(zephyr_display));

/* 20 KiB still saw Invalid SP / illegal insn on render (desk); give more headroom
 * for scene_live_draw + SPI strip buffers + I2C frames under BLE load. */
#define RENDER_THREAD_STACK 32768
#define RENDER_THREAD_PRIO  5

static K_THREAD_STACK_DEFINE(render_stack, RENDER_THREAD_STACK);
static struct k_thread render_thread;

static uint32_t last_hb_ms;
static uint32_t hb_render_frames;
/* Lifetime frame counter for GDB hang-hunt (hb_render_frames resets every 10s). */
volatile uint32_t g_render_frames_total;
static uint32_t render_next_ms;

/*
 * Render-thread stage marker — diagnostic only, added after repeated intermittent "render
 * stall panic" (EXCCAUSE 63, always the same generic k_panic() PC — that's the *main* thread's
 * panic call site, not where the render thread actually got stuck, so it tells us nothing on
 * its own). Recorded by render_thread_fn before/after each of its blocking calls so the next
 * occurrence's "render stalled" log line names the actual hung call and how long it's been
 * stuck there, instead of just "frames==0 for 20s".
 */
enum render_stage {
	RENDER_STAGE_IDLE = 0,
	RENDER_STAGE_SYNC,
	RENDER_STAGE_BACKLIGHT,
	RENDER_STAGE_SNAPSHOT,
	RENDER_STAGE_ZOOM,
	RENDER_STAGE_DRAW,
	RENDER_STAGE_SLEEP,
};

static volatile uint8_t g_render_stage;
static volatile uint32_t g_render_stage_ms;
/* Last main-loop step name — if UART dies mid-call, this is the hung frame. */
static volatile const char *g_main_step = "boot";
static volatile uint32_t g_main_loops;
#define MAIN_STEP(name)                                                                            \
	do {                                                                                       \
		g_main_step = (name);                                                              \
	} while (0)

static const char *render_stage_name(uint8_t stage)
{
	switch (stage) {
	case RENDER_STAGE_SYNC:
		return "power_manager_sync_render";
	case RENDER_STAGE_BACKLIGHT:
		return "panel_backlight_reapply";
	case RENDER_STAGE_SNAPSHOT:
		return "imu_pipeline_snapshot";
	case RENDER_STAGE_ZOOM:
		return "scene_zoom_tick";
	case RENDER_STAGE_DRAW:
		return "scene_live_draw";
	case RENDER_STAGE_SLEEP:
		return "k_msleep";
	default:
		return "idle";
	}
}

static void render_stage_mark(enum render_stage stage)
{
	g_render_stage = (uint8_t)stage;
	g_render_stage_ms = k_uptime_get_32();
}

static bool panel_hw_apply(bool on)
{
	/* Queues if called off the render thread; applies immediately on it. */
	return renderer_request_hw(on);
}

static void ws2812_off(void)
{
	for (int i = 0; i < 3; i++) {
		ws2812_gpio38_off();
		k_msleep(2);
	}
}

static void start_ble(void)
{
	int err = bt_enable(NULL);

	if (err) {
		LOG_ERR("Bluetooth init failed (%d)", err);
		return;
	}

	power_manager_set_bt_controller_on(true);
	stall_watchdog_feed_main();
	ble_net_gatt_init();
	ble_config_gatt_init();
	ble_crash_gatt_init();
	ble_ota_gatt_init();
	ble_imu_gatt_init();
	stall_watchdog_feed_main();
	(void)ble_looper_post_adv_start();
	stall_watchdog_feed_main();
	power_manager_reapply_backlight_if_screen_on();
	stall_watchdog_feed_main();
	LOG_INF("BLE advertising scheduled");
}

static void render_thread_fn(void *p1, void *p2, void *p3)
{
	STACK_RA_CHECK_SETUP;
	ARG_UNUSED(p1);
	ARG_UNUSED(p2);
	ARG_UNUSED(p3);

	stall_watchdog_arm_render();
	renderer_claim_thread();
	renderer_drain(); /* boot HW/present queued from main */
	render_next_ms = k_uptime_get_32();

	while (1) {
		STACK_RA_CHECK();
		const uint32_t now = k_uptime_get_32();
		uint32_t period = power_manager_render_interval_ms();

		/*
		 * Exclusive-epoch panel SPI: pause only while radio_scheduler holds
		 * the panel (MT200 session / WiFi / capture-prep). Phone link must
		 * keep drawing — gating on ble_imu_link_active froze the cube.
		 */
		const bool spi_ok =
			radio_scheduler_panel_spi_allowed() && !renderer_spi_tripped();

		if (!spi_ok) {
			/* Soft trip + radio idle → clear and fall through to redraw.
			 * v307 permanent trip froze the cube while phone AHRS moved. */
			if (renderer_spi_tripped() && radio_scheduler_panel_spi_allowed()) {
				renderer_spi_clear_trip();
			} else {
				/* Never cut SPI mid-flush — wait out in-flight present. */
				if (renderer_busy()) {
					render_stage_mark(RENDER_STAGE_SYNC);
					renderer_drain();
					k_msleep(5);
					continue;
				}
				renderer_set_spi_enabled(false);
				if (period < 500U) {
					period = 500U;
				}
				stall_watchdog_feed_render();
				render_stage_mark(RENDER_STAGE_SLEEP);
				k_msleep(period);
				continue;
			}
		}
		renderer_set_spi_enabled(true);
		/* Cap panel duty — full ~21 Hz fights MSPI under residual BLE. */
		if (period < 200U) {
			period = 200U;
		}
		/* Phone link: keep cube alive but ease MSPI pressure. */
		if (ble_imu_link_active() && period < 250U) {
			period = 250U;
		}
		/* While MT200 feature is armed, keep a gentler floor (~5 Hz). */
		if (mt200_bridge_wanted() && period < 200U) {
			period = 200U;
		}

		stall_watchdog_feed_render();

		/*
		 * flash_area_erase on main — skip SPI drain AND panel HW sync.
		 * Draining present/blanking mid-erase fights MSPI with flash and
		 * has wedged the S3 under dual-role BLE.
		 */
		if (scene_live_flash_quiet()) {
			stall_watchdog_feed_render();
			k_msleep(20);
			continue;
		}

		render_stage_mark(RENDER_STAGE_SYNC);
		renderer_drain();
		power_manager_sync_render();

		if (power_manager_tft_render_enabled()) {
			render_stage_mark(RENDER_STAGE_BACKLIGHT);
			panel_backlight_reapply();
			/* One snapshot inside scene_live_draw (zoom + cube) —
			 * avoid double imu_lock under SPI/I2C pressure. */
			render_stage_mark(RENDER_STAGE_DRAW);
			scene_live_draw(display_dev);
			hb_render_frames++;
			g_render_frames_total++;
			stall_watchdog_feed_render();
		}

		render_next_ms += period;
		if ((int32_t)(render_next_ms - now) <= 0) {
			render_next_ms = now + period;
		}

		const int32_t sleep_ms = (int32_t)(render_next_ms - k_uptime_get_32());

		render_stage_mark(RENDER_STAGE_SLEEP);
		k_msleep(sleep_ms > 0 ? (uint32_t)sleep_ms : 1U);
	}
}

int main(void)
{
	STACK_RA_CHECK_SETUP;
	printk("handshake: main()\n");

	(void)panel_backlight_init();
	boot_button_init();
	ws2812_off();

	if (!device_is_ready(display_dev)) {
		LOG_ERR("display not ready");
		return 0;
	}
	renderer_init(display_dev);
	/* Queue unblank — SPI runs on render thread after claim/drain. */
	(void)renderer_request_hw(true);

	LOG_INF("stage: settings init");
	stall_watchdog_feed_main();
	(void)settings_subsys_init();
	device_config_init();
	soft_reboot_init();
	ota_channel_init();
	ota_ab_init();

	crash_report_init();
	crash_alive_init();
	ota_ab_on_boot();
	soft_reboot_post_boot();
	stall_watchdog_feed_main();

	LOG_INF("stage: config load");
	{
		struct device_config_v1 cfg;

		(void)device_config_load(&cfg);
	}

	LOG_INF("stage: battery/chip temp");
	(void)battery_monitor_init();
	(void)chip_temp_init();

	LOG_INF("stage: power manager");
	power_manager_set_display(display_dev);
	power_manager_set_panel_hw_fn(panel_hw_apply);
	power_manager_set_display_busy_query(renderer_busy);
	power_manager_set_imu_reschedule_cb(imu_pipeline_reschedule);
	power_manager_init();
	battery_bench_init();
	radio_scheduler_init(ble_imu_gatt_set_traffic_paused);

	LOG_INF("stage: network manager");
	network_manager_init();
	ota_wifi_init();

	LOG_INF("%s — MCUboot A/B OTA ch=%s", FW_VERSION_NAME, ota_channel_get());
#if defined(CONFIG_REQUIRES_STACK_CANARIES)
	{
		extern volatile uintptr_t __stack_chk_guard;

		if (__stack_chk_guard == 0U) {
			LOG_ERR("stack_chk_guard is 0 — canaries useless / EXCM risk");
		} else {
			LOG_INF("stack_chk_guard ok (%p)", (void *)__stack_chk_guard);
		}
	}
#endif

	LOG_INF("stage: clock / NTP scheduler");
	clock_sync_ntp_init();

	LOG_INF("stage: stall watchdog");
	if (stall_watchdog_init() != 0) {
		LOG_WRN("stall watchdog init failed");
	}

	LOG_INF("stage: IMU pipeline");
	if (!imu_pipeline_init()) {
		LOG_WRN("IMU pipeline init failed");
	}
	stall_watchdog_feed_main();
#if defined(CONFIG_APP_CRASH_DEBUG)
	bist_run();
#endif
	scene_live_init(display_dev);
	vibro_led_init();
	stall_watchdog_feed_main();

	crash_report_persist_boot_crash();

	LOG_INF("stage: BLE");
	(void)ble_looper_init();
	start_ble();
	mt200_bridge_autostart();
	mt200_sample_queue_init();
	stall_watchdog_feed_main();

	power_manager_mark_ready();
	imu_pipeline_start();
#if defined(CONFIG_APP_CRASH_DEBUG)
	/* Real IMU score after deferred bring-up (early BIST treats who=0x00 as deferred). */
	bist_imu_finalize(3000);
#endif
	stall_watchdog_feed_main();

	k_thread_create(&render_thread, render_stack, K_THREAD_STACK_SIZEOF(render_stack),
			render_thread_fn, NULL, NULL, NULL, RENDER_THREAD_PRIO, 0, K_NO_WAIT);
	k_thread_name_set(&render_thread, "render");

	LOG_INF("stage: main loop (BOOT tap = backlight toggle)");

	while (1) {
		STACK_RA_CHECK();
		const uint32_t now = k_uptime_get_32();

		g_main_loops++;
		if (boot_button_take_toggle_request()) {
			if (!battery_bench_config_locked()) {
				stall_watchdog_feed_main();
				MAIN_STEP("pm_toggle");
				power_manager_toggle_mode();
				stall_watchdog_feed_main();
			}
		}
		MAIN_STEP("boot_btn");
		boot_button_poll();
		STACK_RA_CHECK();
		MAIN_STEP("crash_dbg");
		crash_debug_poll();
		MAIN_STEP("ble_cfg");
		ble_config_gatt_poll();
		STACK_RA_CHECK();
		MAIN_STEP("ble_looper");
		ble_looper_poll();
		STACK_RA_CHECK();
		if (!ble_ota_ui_active()) {
			/*
			 * Never I2C-poll the QMI8658 while panel SPI is in flight.
			 * v310/v311: imu_poll concurrent with flush_y>=0 → LoadProhibited
			 * (EXCCAUSE 28 @ VADDR~0x2c) → DoubleException hang. Desk dump
			 * symbolicated into qmi8658_read/reg_read + fatal/log path.
			 */
			if (!renderer_busy()) {
				MAIN_STEP("imu_poll");
				imu_pipeline_poll();
			} else {
				MAIN_STEP("imu_hold_spi");
			}
		}
		STACK_RA_CHECK();
		MAIN_STEP("dev_cfg");
		device_config_poll();
		MAIN_STEP("ota_ab");
		ota_ab_poll();
		MAIN_STEP("ota_wifi");
		ota_wifi_poll();
		STACK_RA_CHECK();
		if (!ble_ota_ui_active()) {
			MAIN_STEP("ntp");
			clock_sync_ntp_poll();
		}
		if (!ble_ota_ui_active()) {
			MAIN_STEP("batt");
			battery_monitor_tick();
		}
		STACK_RA_CHECK();
		if (!ble_ota_ui_active() && battery_bench_safety_poll()) {
			MAIN_STEP("bench_safe");
			ble_imu_gatt_bench_sample();
		}
		MAIN_STEP("chip_temp");
		chip_temp_tick();
		MAIN_STEP("pm_tick");
		power_manager_tick();
		if (!ble_ota_ui_active() && battery_bench_tick(now)) {
			MAIN_STEP("bench_tick");
			ble_imu_gatt_bench_sample();
		}
		if (!ble_ota_ui_active()) {
			MAIN_STEP("net");
			network_manager_tick();
			MAIN_STEP("ble_net");
			ble_net_gatt_tick();
		}
		MAIN_STEP("ble_ota");
		ble_ota_gatt_tick();
		if (!ble_ota_ui_active()) {
			MAIN_STEP("vibro");
			vibro_capture_session_tick(now);
			vibro_capture_poll();
			vibro_led_poll();
		}
		{
			const struct device_config_v1 *dcfg = device_config_runtime();

			MAIN_STEP("radio_sched");
			radio_scheduler_set_capture_prep(
				vibro_schedule_capture_prep_active(dcfg, clock_sync_now_ms32()));
		}

		MAIN_STEP("wdt_feed");
		stall_watchdog_feed_main();
		if (!power_manager_tft_render_enabled()) {
			stall_watchdog_feed_render();
		}

		/* Stall breadcrumb every 5s — last step name survives if the next call wedges. */
		{
			static uint32_t last_step_hb_ms;

			if (last_step_hb_ms == 0U || (now - last_step_hb_ms) >= 5000U) {
				last_step_hb_ms = now;
				/* Feed WDT *before* USB printk — a wedged CDC must not starve soft WDT. */
				stall_watchdog_feed_main();
				/* printk first — survives USB CDC backpressure better than
				 * LOG_IMMEDIATE (and still useful under deferred logging). */
				printk("main_hb ok loops=%u step=%s render=%s phone=%u mt200=%u\n",
				       g_main_loops, g_main_step ? g_main_step : "?",
				       render_stage_name(g_render_stage),
				       ble_imu_link_active() ? 1U : 0U,
				       mt200_bridge_wanted() ? (mt200_bridge_radio_busy() ? 2U : 1U)
							     : 0U);
				/* printk is the soak heartbeat; skip duplicate LOG under IMMEDIATE. */
			}
		}

		if (last_hb_ms == 0U) {
			last_hb_ms = now;
		} else if (now - last_hb_ms >= 10000U) {
			MAIN_STEP("hb10");
			const uint32_t window = now - last_hb_ms;
			const bool screen_on = power_manager_tft_render_enabled();

			const uint32_t imu_ticks = imu_pipeline_take_hb_ticks();

			stall_watchdog_hb_window(hb_render_frames, screen_on, imu_ticks);
			crash_alive_mark_running(now, g_main_step ? (const char *)g_main_step : "?",
						 g_render_stage);

			if (screen_on && hb_render_frames == 0U) {
				const uint8_t stage = g_render_stage;
				char spi_info[64];

				(void)renderer_stall_info(spi_info, sizeof(spi_info));
				LOG_WRN("render stalled (%ums) — nudge panel on render thread "
					"(stuck@%s for %ums) spi: %s",
					window, render_stage_name(stage),
					now - g_render_stage_ms, spi_info);
				panel_backlight_reapply();
				power_manager_request_panel_hw(true);
			}

			/* OTA skips imu_pipeline_poll — do not treat that as a stall
			 * and kick recover/cal onto the IMU wq during flash erase. */
			if (screen_on && imu_ticks == 0U && power_manager_imu_hz_target() > 0U &&
			    !ble_ota_ui_active() && !imu_pipeline_recovering()) {
				LOG_WRN("IMU stalled (%ums) — recover", window);
				imu_pipeline_request_recover();
			}

			/* Load-shed pauses work; keep HB logs quiet too during OTA UI. */
			if (!ble_ota_ui_active()) {
				MAIN_STEP("telemetry");
				power_manager_log_telemetry(hb_render_frames, imu_ticks, window,
							    renderer_last_present_ms());
				imu_pipeline_log_motion();
			}
			hb_render_frames = 0;
			last_hb_ms = now;
		}

		MAIN_STEP("sleep");
		k_msleep(power_manager_main_sleep_ms());
		MAIN_STEP("loop");
	}

	return 0;
}
```

## src/ble_config_gatt.c
```c
#include "ble_config_gatt.h"

#include <string.h>

#include <zephyr/bluetooth/gatt.h>
#include <zephyr/bluetooth/uuid.h>
#include <zephyr/logging/log.h>

#include "battery_bench.h"
#include "device_config.h"
#include "flash_safety.h"
#include "floor_calib.h"
#include "imu_pipeline.h"
#include "ota_channel.h"
#include "soft_reboot.h"
#include "vibro_led.h"
#include "vibro_capture.h"

#include <zephyr/kernel.h>
#include <zephyr/sys/atomic.h>
#include <zephyr/sys/reboot.h>
#include <zephyr/sys/util.h>

LOG_MODULE_REGISTER(ble_cfg, LOG_LEVEL_INF);

#define BT_UUID_CONFIG_SVC_VAL \
	BT_UUID_128_ENCODE(0x4a6e0101, 0x0000, 0x1000, 0x8000, 0x00805f9b34fb)
#define BT_UUID_CONFIG_DATA_VAL \
	BT_UUID_128_ENCODE(0x4a6e0102, 0x0000, 0x1000, 0x8000, 0x00805f9b34fb)
#define BT_UUID_CONFIG_CMD_VAL \
	BT_UUID_128_ENCODE(0x4a6e0103, 0x0000, 0x1000, 0x8000, 0x00805f9b34fb)
/** Read-only: compact JSON list of the 5 reference-profile slots (name/
 * duration/rms/valid + which one is active). See vibro_ref_store.h. */
#define BT_UUID_CONFIG_REFLIST_VAL \
	BT_UUID_128_ENCODE(0x4a6e0104, 0x0000, 0x1000, 0x8000, 0x00805f9b34fb)
/** Read-only: flat-floor mounting calibration status JSON — see floor_calib.h. */
#define BT_UUID_CONFIG_FLOORCAL_VAL \
	BT_UUID_128_ENCODE(0x4a6e0105, 0x0000, 0x1000, 0x8000, 0x00805f9b34fb)

static struct bt_uuid_128 cfg_svc_uuid = BT_UUID_INIT_128(BT_UUID_CONFIG_SVC_VAL);
static struct bt_uuid_128 cfg_data_uuid = BT_UUID_INIT_128(BT_UUID_CONFIG_DATA_VAL);
static struct bt_uuid_128 cfg_cmd_uuid = BT_UUID_INIT_128(BT_UUID_CONFIG_CMD_VAL);
static struct bt_uuid_128 cfg_reflist_uuid = BT_UUID_INIT_128(BT_UUID_CONFIG_REFLIST_VAL);
static struct bt_uuid_128 cfg_floorcal_uuid = BT_UUID_INIT_128(BT_UUID_CONFIG_FLOORCAL_VAL);

static char g_reflist_json[640];
static size_t g_reflist_len;
static char g_floorcal_json[128];
static size_t g_floorcal_len;

static struct device_config_v1 g_cfg;

static atomic_t g_erase_reboot_pending;
static int64_t g_erase_reboot_deadline;
/* Bounded wait for app_flash_erase_safe() before the factory-reset NVS erase — see
 * flash_safety.h. This is a rare, deliberate action that already reboots right after, so
 * unlike the other stores we don't need a full deferred-ram pattern: just give BLE a chance
 * to go idle first, but don't block a user-requested factory reset forever if it doesn't
 * (e.g. app never disconnects) — bail out and erase anyway once the cap is hit. */
#define DEVCFG_ERASE_SAFE_WAIT_CAP_MS 5000

static void erase_nvs_and_reboot_now(void)
{
	if (device_config_storage_erase()) {
		device_config_defaults(&g_cfg);
		if (!device_config_save_sync(&g_cfg)) {
			LOG_ERR("devcfg post-erase save failed — defaults apply in RAM until next boot");
		}
	} else {
		LOG_ERR("devcfg NVS erase failed — rebooting without wipe");
	}
	LOG_WRN("devcfg: sys_reboot after NVS erase");
	k_msleep(100);
	soft_reboot_schedule(SOFT_REBOOT_BOOT_BTN, soft_reboot_boot_partition(), 255U);
	sys_reboot(SYS_REBOOT_COLD);
}

static void reload_cfg(void)
{
	(void)device_config_load(&g_cfg);
}

static ssize_t read_data(struct bt_conn *conn, const struct bt_gatt_attr *attr, void *buf,
			 uint16_t len, uint16_t offset)
{
	ARG_UNUSED(conn);
	ARG_UNUSED(attr);
	reload_cfg();
	return bt_gatt_attr_read(conn, attr, buf, len, offset, &g_cfg, sizeof(g_cfg));
}

static ssize_t write_data(struct bt_conn *conn, const struct bt_gatt_attr *attr, const void *buf,
			  uint16_t len, uint16_t offset, uint8_t flags)
{
	ARG_UNUSED(conn);
	ARG_UNUSED(attr);
	ARG_UNUSED(flags);

	if (offset != 0 || len != sizeof(struct device_config_v1)) {
		return BT_GATT_ERR(BT_ATT_ERR_INVALID_ATTRIBUTE_LEN);
	}
	if (battery_bench_config_locked()) {
		return BT_GATT_ERR(BT_ATT_ERR_WRITE_NOT_PERMITTED);
	}
	const enum device_config_apply_result ar = device_config_apply_remote(buf);

	if (ar == DEVICE_CONFIG_APPLY_STALE) {
		return BT_GATT_ERR(BT_ATT_ERR_WRITE_NOT_PERMITTED);
	}
	if (ar != DEVICE_CONFIG_APPLY_OK) {
		return BT_GATT_ERR(BT_ATT_ERR_VALUE_NOT_ALLOWED);
	}
	reload_cfg();
	imu_pipeline_apply_config();
	return len;
}

static ssize_t read_reflist(struct bt_conn *conn, const struct bt_gatt_attr *attr, void *buf,
			    uint16_t len, uint16_t offset)
{
	ARG_UNUSED(conn);
	ARG_UNUSED(attr);

	/* Rebuild only at the start of a read sequence — see the STATUS/DATA
	 * torn-read comment in ble_imu_gatt.c for why a multi-part ATT long
	 * read must stay on one generation of the buffer for its whole
	 * transfer. This store isn't touched by any background poll, so a
	 * single static buffer (no double-buffering) is sufficient. */
	if (offset == 0U) {
		const int n = vibro_capture_list_references_json(g_reflist_json,
								  sizeof(g_reflist_json));

		g_reflist_len = (n > 0) ? (size_t)n : 0U;
	}
	return bt_gatt_attr_read(conn, attr, buf, len, offset, g_reflist_json, g_reflist_len);
}

static ssize_t read_floorcal(struct bt_conn *conn, const struct bt_gatt_attr *attr, void *buf,
			     uint16_t len, uint16_t offset)
{
	ARG_UNUSED(conn);
	ARG_UNUSED(attr);

	if (offset == 0U) {
		const int n = floor_calib_status_json(g_floorcal_json, sizeof(g_floorcal_json));

		g_floorcal_len = (n > 0) ? (size_t)n : 0U;
	}
	return bt_gatt_attr_read(conn, attr, buf, len, offset, g_floorcal_json, g_floorcal_len);
}

static ssize_t write_cmd(struct bt_conn *conn, const struct bt_gatt_attr *attr, const void *buf,
			 uint16_t len, uint16_t offset, uint8_t flags)
{
	ARG_UNUSED(conn);
	ARG_UNUSED(attr);
	ARG_UNUSED(flags);

	if (offset != 0 || len == 0) {
		return BT_GATT_ERR(BT_ATT_ERR_INVALID_ATTRIBUTE_LEN);
	}
	if (battery_bench_config_locked()) {
		return BT_GATT_ERR(BT_ATT_ERR_WRITE_NOT_PERMITTED);
	}

	const uint8_t *bytes = buf;
	const uint8_t cmd = bytes[0];

	switch (cmd) {
	case 0:
		reload_cfg();
		imu_pipeline_apply_config();
		break;
	case 1:
		reload_cfg();
		imu_pipeline_apply_config();
		LOG_INF("devcfg commit applied");
		break;
	case 3: {
		/* Payload: [3][slot][name...] — slot/name optional for back-compat
		 * (bare [3] == slot 0, auto-named). */
		const uint8_t slot = (len >= 2) ? bytes[1] : 0U;
		char name[VIBRO_REF_NAME_MAX];

		name[0] = '\0';
		if (len > 2) {
			const size_t name_len = MIN((size_t)(len - 2), sizeof(name) - 1U);

			memcpy(name, &bytes[2], name_len);
			name[name_len] = '\0';
		}
		(void)vibro_capture_start_reference(slot, name);
		break;
	}
	case 4:
		(void)vibro_capture_stop_reference();
		LOG_INF("vibro reference stopped len=%u", (unsigned)vibro_capture_reference_len());
		break;
	case 7:
		if (len >= 2) {
			const int err = vibro_capture_select_reference(bytes[1]);

			LOG_INF("vibro reference select slot=%u -> %d", bytes[1], err);
		}
		break;
	case 8:
		if (len >= 2) {
			const int err = vibro_capture_delete_reference(bytes[1]);

			LOG_INF("vibro reference delete slot=%u -> %d", bytes[1], err);
		}
		break;
	case 9:
		(void)vibro_capture_clear_all_references();
		device_config_set_vibro_armed(false);
		LOG_WRN("vibro reference: all slots cleared (CMD 9)");
		break;
	case 10:
		vibro_capture_set_sensing_paused(false);
		device_config_set_vibro_armed(true);
		LOG_INF("vibro monitoring armed (CMD 10) — pause cleared, acrylic LED operational");
		break;
	case 14:
		/* [14] or [14][1] = pause persist (repair). [14][0] = resume persist. */
		vibro_capture_set_sensing_paused(len < 2 || bytes[1] != 0U);
		break;
	case 5:
		if (len >= 5) {
			const uint32_t seq = (uint32_t)bytes[1] | ((uint32_t)bytes[2] << 8) |
					     ((uint32_t)bytes[3] << 16) | ((uint32_t)bytes[4] << 24);

			if (vibro_capture_ack_offload(seq)) {
				LOG_INF("offload ACK seq=%u — ring rotated", seq);
			} else {
				LOG_WRN("offload ACK seq=%u ignored", seq);
			}
		}
		break;
	case 6:
		LOG_WRN("devcfg erase NVS scheduled (reboot in 500ms, main poll)");
		g_erase_reboot_deadline = k_uptime_get() + 500;
		atomic_set(&g_erase_reboot_pending, 1);
		break;
	case 11: {
		/* Payload: [11][duration_ms lo][duration_ms hi] — duration optional
		 * (bare [11] == FLOOR_CALIB_DEFAULT_DURATION_MS). Device must be held
		 * still on a true-level reference for the whole window. */
		const uint16_t duration_ms =
			(len >= 3) ? (uint16_t)(bytes[1] | ((uint16_t)bytes[2] << 8)) : 0U;

		floor_calib_start(duration_ms);
		break;
	}
	case 12:
		floor_calib_clear();
		break;
	case 13:
		/* [13][0] = release schema. [13][1][mask] = debug; mask bits 1=R 2=G 4=B. */
		if (len >= 2 && bytes[1] == 0U) {
			vibro_led_debug_set(false, 0U);
		} else {
			vibro_led_debug_set(true, (len >= 3) ? bytes[2] : 0U);
		}
		break;
	case 15: {
		/* [15][channel ascii…] — stable|staging|dev (phone CDN sync). */
		char ch[OTA_CHANNEL_MAX + 1];
		const size_t n = (len > 1U) ? MIN((size_t)(len - 1U), (size_t)OTA_CHANNEL_MAX) : 0U;

		if (n == 0U) {
			(void)ota_channel_set("stable");
		} else {
			memcpy(ch, &bytes[1], n);
			ch[n] = '\0';
			(void)ota_channel_set(ch);
		}
		break;
	}
	default:
		break;
	}
	return len;
}

BT_GATT_SERVICE_DEFINE(
	cfg_svc, BT_GATT_PRIMARY_SERVICE(&cfg_svc_uuid),
	BT_GATT_CHARACTERISTIC(&cfg_data_uuid.uuid, BT_GATT_CHRC_READ | BT_GATT_CHRC_WRITE,
			       BT_GATT_PERM_READ | BT_GATT_PERM_WRITE, read_data, write_data, NULL),
	BT_GATT_CHARACTERISTIC(&cfg_cmd_uuid.uuid, BT_GATT_CHRC_WRITE, BT_GATT_PERM_WRITE, NULL,
			       write_cmd, NULL),
	BT_GATT_CHARACTERISTIC(&cfg_reflist_uuid.uuid, BT_GATT_CHRC_READ, BT_GATT_PERM_READ,
			       read_reflist, NULL, NULL),
	BT_GATT_CHARACTERISTIC(&cfg_floorcal_uuid.uuid, BT_GATT_CHRC_READ, BT_GATT_PERM_READ,
			       read_floorcal, NULL, NULL), );

int ble_config_gatt_init(void)
{
	atomic_set(&g_erase_reboot_pending, 0);
	reload_cfg();
	LOG_INF("BLE config service registered");
	return 0;
}

void ble_config_gatt_poll(void)
{
	if (!atomic_get(&g_erase_reboot_pending)) {
		return;
	}

	if (k_uptime_get() < g_erase_reboot_deadline) {
		return;
	}

	if (!app_flash_erase_safe() &&
	    k_uptime_get() < g_erase_reboot_deadline + DEVCFG_ERASE_SAFE_WAIT_CAP_MS) {
		return;
	}
	if (!app_flash_erase_safe()) {
		LOG_WRN("devcfg erase: BLE still active after %dms wait cap — erasing anyway",
			DEVCFG_ERASE_SAFE_WAIT_CAP_MS);
	}

	atomic_set(&g_erase_reboot_pending, 0);
	erase_nvs_and_reboot_now();
}
```

## src/ble_config_gatt.h
```c
#pragma once

int ble_config_gatt_init(void);
void ble_config_gatt_poll(void);
```

## src/ble_crash_gatt.h
```c
#pragma once

#include <stdbool.h>

int ble_crash_gatt_init(void);
bool ble_crash_gatt_pending(void);
void ble_crash_gatt_looper_tick(void);
```

## src/ble_imu_gatt.h
```c
#pragma once

#include <zephyr/bluetooth/conn.h>

/** Post-connect quiet window — phone should defer MODE/TIME/poll/crash/offload until this
 *  elapses (see ble_imu_gatt.c ble_traffic_ready()). Android ImuProtocol.ESP_CONNECT_SETTLE_MS. */
#define BLE_IMU_CONNECT_GRACE_MS 2000
#define BLE_IMU_POST_GRACE_MS    500

int ble_imu_gatt_init(void);
void ble_imu_gatt_set_traffic_paused(bool paused);
/** True when there is no phone link, or its interval is already ≥200 ms (WiFi can scan). */
bool ble_imu_phone_conn_quiet_for_wifi(void);
/** Re-issue the stretched phone LE interval while waiting to start a WiFi scan. */
void ble_imu_phone_stretch_for_wifi(void);
/** Hold advertising so a WiFi scan can own the 2.4 GHz radio with no BLE traffic. */
void ble_imu_set_hold_adv(bool hold);
/** Hold advertising only while an MT200 central session is live (scan/connect/fetch). */
void ble_imu_set_mt200_adv_hold(bool hold);
/** Drop the phone link after the scan GATT write has completed. */
void ble_imu_disconnect_phone_for_wifi(void);
bool ble_imu_link_active(void);
bool ble_imu_in_connect_grace(void);

/** True once the link has been up for at least (grace + post-grace + extra_margin_ms).
 *  Originally used to keep flash-erase-heavy BLE control ops (e.g. crash-ring clear) away from
 *  the connection-establishment window — turned out a live connection is unsafe for that at
 *  ANY offset, not just near that boundary (see ble_imu_disconnected_settled() and
 *  crash_ring_flush_ram_clears() for the actual fix). Still used for other deferred ops that
 *  only need to avoid the raw connect/grace-elapse windows. Returns false while disconnected. */
bool ble_imu_connect_settled(uint32_t extra_margin_ms);

/** True once there has been NO BLE connection at all for at least min_idle_ms — i.e. the link
 *  layer has fully torn down. See crash_ring_flush_ram_clears()'s doc comment for why a flash
 *  erase needs this instead of merely being "far enough" into a live connection. */
bool ble_imu_disconnected_settled(uint32_t min_idle_ms);

/** Called only from ble_looper thread. */
void ble_imu_gatt_looper_tick(void);
void ble_imu_gatt_looper_connected(struct bt_conn *conn);
void ble_imu_gatt_looper_disconnected(uint8_t reason);
int ble_imu_gatt_looper_adv_start(bool restart);

/** Push STATUS after a battery-bench sample tick (main loop only). */
void ble_imu_gatt_bench_sample(void);

/** bt_conn callbacks — enqueue to ble_looper only. */
void ble_imu_on_connected(struct bt_conn *conn, uint8_t err);
void ble_imu_on_disconnected(struct bt_conn *conn, uint8_t reason);
```

## src/ble_looper.h
```c
#pragma once

#include <stdint.h>

#include <zephyr/bluetooth/conn.h>

/** Main-thread FIFO looper: BT callbacks enqueue, main drains in ble_looper_poll(). */
int ble_looper_init(void);

/** Drain pending BLE events then run GATT tick — call from main loop only. */
void ble_looper_poll(void);

int ble_looper_post_connected(struct bt_conn *conn, uint8_t err);
int ble_looper_post_disconnected(uint8_t reason);
int ble_looper_post_adv_start(void);
int ble_looper_post_adv_restart(void);
```

## src/ble_net_gatt.h
```c
#pragma once

int ble_net_gatt_init(void);
void ble_net_gatt_tick(void);
```

## src/ble_ota_gatt.h
```c
#pragma once

#include <stdbool.h>
#include <stddef.h>
#include <stdint.h>

int ble_ota_gatt_init(void);
/** Drive slot pre-erase / FAIL hold / delayed reboot (call from main loop). */
void ble_ota_gatt_tick(void);

/** True while OTA UI owns the panel (upgrade / FAIL hold / REBOOT). */
bool ble_ota_ui_active(void);

/**
 * Snapshot for the OTA panel. Returns false when idle (caller draws cube).
 * progress_permille: 0..1000. label is a static string (FAIL / REBOOT / Upgrading…).
 * label_rgb565 / bar_rgb565: panel colors.
 */
bool ble_ota_ui_snapshot(const char **label, uint16_t *label_rgb565, uint16_t *bar_rgb565,
			 uint16_t *progress_permille);
```
