## CMakeLists.txt
```
cmake_minimum_required(VERSION 3.20.0)
find_package(Zephyr REQUIRED HINTS $ENV{ZEPHYR_BASE})
project(waveshare_smoke)

# Prefer space-free west links (same pattern as handshake).
set(_link_common "")
if(DEFINED ENV{ZEPHYR_PROJECT} AND EXISTS "$ENV{ZEPHYR_PROJECT}/waveshare-common/fw_version.h")
  set(_link_common "$ENV{ZEPHYR_PROJECT}/waveshare-common")
elseif(DEFINED ENV{HOME} AND EXISTS "$ENV{HOME}/zephyrproject/waveshare-common/fw_version.h")
  set(_link_common "$ENV{HOME}/zephyrproject/waveshare-common")
endif()
if(_link_common)
  set(COMMON_DIR "${_link_common}")
else()
  get_filename_component(APP_ROOT ${CMAKE_CURRENT_SOURCE_DIR} REALPATH)
  set(COMMON_DIR ${APP_ROOT}/../common)
endif()

target_include_directories(app PRIVATE ${COMMON_DIR})

target_sources(app PRIVATE
  src/main.c
  src/ws2812_gpio38.c
  src/wdt_stubs.c
  ${COMMON_DIR}/renderer.c
  ${COMMON_DIR}/panel_backlight.c
)
```

## prj.conf
```kconfig
CONFIG_MAIN_STACK_SIZE=8192
CONFIG_HEAP_MEM_POOL_SIZE=65536
CONFIG_SYSTEM_WORKQUEUE_STACK_SIZE=2048
CONFIG_LOG=y
CONFIG_DISPLAY=y
CONFIG_INPUT=y
CONFIG_GPIO=y
CONFIG_PWM=y

# PSRAM for the shared renderer framebuffer (.ext_ram.bss).
CONFIG_ESP_SPIRAM=y
CONFIG_ESP_SPIRAM_SIZE=8388608
CONFIG_ESP_SPIRAM_HEAP_SIZE=524288

CONFIG_BT=y
CONFIG_BT_PERIPHERAL=y
CONFIG_BT_DEVICE_NAME="WS147B-Zephyr"
CONFIG_BT_DEVICE_NAME_DYNAMIC=n
CONFIG_BT_MAX_CONN=1
CONFIG_BT_MAX_PAIRED=0
```

## src/main.c
```c
/*
 * Waveshare ESP32-S3-LCD-1.47B smoke test:
 * - ST7789 corners via shared renderer (sole display_write site)
 * - WS2812 off via GPIO38 bitbang
 * - BOOT press → yellow bar flash + serial log
 * - BLE connectable advertising (nRF Connect)
 */

#include <zephyr/bluetooth/bluetooth.h>
#include <zephyr/bluetooth/hci.h>
#include <zephyr/device.h>
#include <zephyr/devicetree.h>
#include <zephyr/drivers/gpio.h>
#include <zephyr/dt-bindings/input/input-event-codes.h>
#include <zephyr/input/input.h>
#include <zephyr/kernel.h>
#include <zephyr/logging/log.h>

#include "display_panel.h"
#include "renderer.h"
#include "ws2812_gpio38.h"

LOG_MODULE_REGISTER(smoke, LOG_LEVEL_INF);

static const struct device *const display_dev =
	DEVICE_DT_GET(DT_CHOSEN(zephyr_display));

static struct gpio_dt_spec boot_btn = GPIO_DT_SPEC_GET(DT_ALIAS(sw0), gpios);
static volatile uint32_t boot_presses;
static volatile bool boot_pending;

static const struct bt_data ad[] = {
	BT_DATA_BYTES(BT_DATA_FLAGS, (BT_LE_AD_GENERAL | BT_LE_AD_NO_BREDR)),
};

static const struct bt_data sd[] = {
	BT_DATA(BT_DATA_NAME_COMPLETE, CONFIG_BT_DEVICE_NAME,
		sizeof(CONFIG_BT_DEVICE_NAME) - 1),
};

static void ws2812_off(void)
{
	for (int i = 0; i < 3; i++) {
		ws2812_gpio38_off();
		k_msleep(5);
	}
	LOG_INF("WS2812 off (GPIO38 bitbang x3)");
}

static void draw_corners(void)
{
	const uint16_t w = 48;
	const uint16_t h = 48;
	const uint16_t colors[4] = {PANEL_RED, PANEL_GREEN, PANEL_BLUE, PANEL_GREY};
	const uint16_t xs[4] = {0, PANEL_W - w, PANEL_W - w, 0};
	const uint16_t ys[4] = {0, 0, PANEL_H - h, PANEL_H - h};

	renderer_begin(PANEL_BLACK);
	for (int i = 0; i < 4; i++) {
		renderer_fill_rect(xs[i], ys[i], w, h, colors[i]);
	}
	renderer_present();
	(void)renderer_request_hw(true);
}

static void boot_feedback(void)
{
	const uint16_t y0 = PANEL_H / 2 - PANEL_BAR_H / 2;

	renderer_begin(PANEL_BLACK);
	renderer_fill_rect(0, y0, PANEL_W, PANEL_BAR_H, PANEL_YELLOW);
	renderer_present();
	k_msleep(250);
	draw_corners();
}

static void start_ble(void)
{
	int err = bt_enable(NULL);

	if (err) {
		LOG_ERR("Bluetooth init failed (%d)", err);
		return;
	}

	err = bt_le_adv_start(BT_LE_ADV_CONN_FAST_2, ad, ARRAY_SIZE(ad), sd, ARRAY_SIZE(sd));
	if (err) {
		LOG_ERR("BLE advertising failed (%d)", err);
		return;
	}

	LOG_INF("BLE advertising as \"%s\"", CONFIG_BT_DEVICE_NAME);
}

static void input_cb(struct input_event *evt, void *user_data)
{
	ARG_UNUSED(user_data);
	if (evt->type == INPUT_EV_KEY && evt->code == INPUT_KEY_0 && evt->value != 0) {
		boot_presses++;
		boot_pending = true;
	}
}

INPUT_CALLBACK_DEFINE(NULL, input_cb, NULL);

int main(void)
{
	if (!device_is_ready(display_dev)) {
		LOG_ERR("display not ready");
		return 0;
	}

	LOG_INF("Waveshare 1.47B smoke — LCD + WS2812 + BOOT + BLE");
	ws2812_off();

	/* Smoke is single-threaded: claim main as the sole SPI owner. */
	renderer_init(display_dev);
	renderer_claim_thread();
	(void)renderer_request_hw(true);
	draw_corners();

	start_ble();
	LOG_INF("BOOT GPIO%d — press for yellow bar flash", boot_btn.pin);

	while (1) {
		if (boot_pending) {
			boot_pending = false;
			LOG_INF("BOOT pressed (%u)", boot_presses);
			boot_feedback();
		}

		k_msleep(20);
	}

	return 0;
}
```

## src/wdt_stubs.c
```c
/* Smoke does not arm the soft stall WDT — satisfy renderer references. */

void stall_watchdog_feed_render(void)
{
}

void stall_watchdog_feed_main(void)
{
}
```

## src/ws2812_gpio38.c
```c
/*
 * WS2812 on GPIO38 — bit-bang, same GRB frame as Arduino rgbLedWrite().
 * Cycle-counted WS2812B timings (see handshake copy for the stuck-channel note).
 */

#include <zephyr/kernel.h>
#include <zephyr/irq.h>
#include <zephyr/drivers/gpio.h>
#include <zephyr/device.h>
#include <esp_cpu.h>
#include <esp_rom_sys.h>
#include <soc/gpio_reg.h>

#include "ws2812_gpio38.h"

#define WS2812_PIN 6 /* GPIO38 = gpio1 pin 6 */

static const struct device *gpio1_dev;
static bool gpio_ready;

static inline void wait_until(uint32_t start, uint32_t ticks)
{
	while ((esp_cpu_get_cycle_count() - start) < ticks) {
	}
}

static void ws2812_send_bit(bool one)
{
	const uint32_t tpus = esp_rom_get_cpu_ticks_per_us();
	const uint32_t th = one ? ((tpus * 70U) / 100U) : ((tpus * 35U) / 100U);
	const uint32_t tl = one ? ((tpus * 60U) / 100U) : ((tpus * 80U) / 100U);
	const uint32_t t0 = esp_cpu_get_cycle_count();

	REG_WRITE(GPIO_OUT1_W1TS_REG, BIT(WS2812_PIN));
	wait_until(t0, th);
	REG_WRITE(GPIO_OUT1_W1TC_REG, BIT(WS2812_PIN));
	wait_until(t0, th + tl);
}

static void ws2812_send_byte(uint8_t byte)
{
	for (int i = 7; i >= 0; i--) {
		ws2812_send_bit((byte >> i) & 1);
	}
}

int ws2812_gpio38_init(void)
{
	gpio1_dev = DEVICE_DT_GET(DT_NODELABEL(gpio1));

	if (!device_is_ready(gpio1_dev)) {
		return -ENODEV;
	}

	if (gpio_pin_configure(gpio1_dev, WS2812_PIN, GPIO_OUTPUT_INACTIVE) != 0) {
		return -EIO;
	}

	REG_WRITE(GPIO_OUT1_W1TC_REG, BIT(WS2812_PIN));
	gpio_ready = true;
	return 0;
}

void ws2812_gpio38_rgb(uint8_t r, uint8_t g, uint8_t b)
{
	unsigned int key;

	if (!gpio_ready && ws2812_gpio38_init() != 0) {
		return;
	}

	REG_WRITE(GPIO_OUT1_W1TC_REG, BIT(WS2812_PIN));
	esp_rom_delay_us(300);

	key = irq_lock();
	ws2812_send_byte(r);
	ws2812_send_byte(g);
	ws2812_send_byte(b);
	irq_unlock(key);

	REG_WRITE(GPIO_OUT1_W1TC_REG, BIT(WS2812_PIN));
	esp_rom_delay_us(300);
}

void ws2812_gpio38_off(void)
{
	ws2812_gpio38_rgb(0, 0, 0);
}
```

## src/ws2812_gpio38.h
```c
#pragma once

#include <stdint.h>

void ws2812_gpio38_rgb(uint8_t r, uint8_t g, uint8_t b);
void ws2812_gpio38_off(void);
int ws2812_gpio38_init(void);
```
