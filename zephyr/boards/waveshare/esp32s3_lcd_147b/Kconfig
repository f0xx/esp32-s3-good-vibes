## zephyr/boards/waveshare/esp32s3_lcd_147b/Kconfig.defconfig
```kconfig
# Waveshare ESP32-S3-LCD-1.47B

config ENTROPY_GENERATOR
	default y

config KERNEL_MEM_POOL
	default y

config PWM
	default y if DISPLAY
```

## zephyr/boards/waveshare/esp32s3_lcd_147b/Kconfig.esp32s3_lcd_147b
```kconfig
# Waveshare ESP32-S3-LCD-1.47B

config BOARD_ESP32S3_LCD_147B
	select SOC_ESP32S3_R2
```

## zephyr/boards/waveshare/esp32s3_lcd_147b/board.yml
```yaml
board:
  name: esp32s3_lcd_147b
  full_name: ESP32-S3-LCD-1.47B
  vendor: waveshare
  socs:
  - name: esp32s3
```
